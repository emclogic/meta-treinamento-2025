## Kconfig
```kconfig
# Selecao do tipo de imagem
choice
    prompt "Selecione a Imagem"
    default BUILD_IMAGE_MINIMAL

config BUILD_IMAGE_MINIMAL
    bool "core-image-console"

config BUILD_IMAGE_WESTON
    bool "core-image-grafico"

config BUILD_IMAGE_RAUC
    bool "core-image-rauc"

endchoice

# Selecao do tipo de dispositivo
choice
    prompt "Selecione o target"
    default MACHINE_RASPBERRYPI3

config MACHINE_QEMU_X86_64
    bool "qemux86-64"
    select PLATFORM_QEMU_X86_64

config MACHINE_RASPBERRYPI3
    bool "RASPBERRYPI3-64"
    select PLATAFORM_RASPBERRYPI3

config MACHINE_RASPBERRYPI3-RAUC
    bool "RASPBERRYPI3-64-RAUC"
    select PLATAFORM_RASPBERRYPI3

config MACHINE_BANANAPI-M64
    bool "BANANAPI-M64"
    select PLATAFORM_BANANAPI-M64

endchoice

config KAS_TARGET_BUILD
        string
        default "core-image-console" if BUILD_IMAGE_MINIMAL
        default "core-image-grafico" if BUILD_IMAGE_WESTON
        default "core-image-minimal" if BUILD_IMAGE_RAUC

config KAS_INCLUDE_MACHINE
    string
    default "kas/machines/qemux86-64.yaml" if MACHINE_QEMU_X86_64
    default "kas/machines/raspberrypi3.yaml" if MACHINE_RASPBERRYPI3
    default "kas/machines/raspberrypi3-rauc.yaml" if MACHINE_RASPBERRYPI3-RAUC
    default "kas/machines/bananapi-m64.yaml" if MACHINE_BANANAPI-M64

config KAS_INCLUDE_BSP
    string
    default "kas/scarthgap-base.yaml"
```

## conf/layer.conf
```bitbake
# We have a conf and classes directory, add to BBPATH
BBPATH .= ":${LAYERDIR}"

# We have recipes-* directories, add to BBFILES
BBFILES += "${LAYERDIR}/recipes-*/*/*.bb \
            ${LAYERDIR}/recipes-*/*/*.bbappend"

BBFILE_COLLECTIONS += "meta-treinamento"
BBFILE_PATTERN_meta-treinamento = "^${LAYERDIR}/"
BBFILE_PRIORITY_meta-treinamento = "5"

LAYERDEPENDS_meta-treinamento = "core"
LAYERSERIES_COMPAT_meta-treinamento = "kirkstone scarthgap"
```
